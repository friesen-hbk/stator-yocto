## meta-ngt/conf/layer.conf
```bitbake
# We have a conf and classes directory, add to BBPATH
BBPATH .= ":${LAYERDIR}"

# We have recipes-* directories, add to BBFILES
BBFILES += "${LAYERDIR}/recipes-*/*/*.bb \
            ${LAYERDIR}/recipes-*/*/*.bbappend"

BBFILE_COLLECTIONS += "meta-ngt"
BBFILE_PATTERN_meta-ngt = "^${LAYERDIR}/"
BBFILE_PRIORITY_meta-ngt = "6"

LAYERDEPENDS_meta-ngt = "core"
LAYERSERIES_COMPAT_meta-ngt = "warrior zeus"
```

## meta-ngt/conf/machine/atlas-board.conf
```bitbake
#@TYPE: Machine
#@NAME: Terrasic Atlas Board
#@SOC: SocFPGA
#@DESCRIPTION: Machine configuration for Terrasic Atlas Board

### from openembedded-core/meta/conf/machine/include
require conf/machine/include/tune-cortexa9.inc

KERNEL_PROVIDER ?= "linux-ngt"
PREFERRED_PROVIDER_virtual/kernel ?= "${KERNEL_PROVIDER}"

PREFERRED_PROVIDER_virtual/bootloader ?= "barebox-atlas"
PREFERRED_PROVIDER_virtual/pre-bootloader ?= "barebox-xload-atlas"


EXTRA_IMAGEDEPENDS += " \
		virtual/pre-bootloader \
		virtual/bootloader \
		"


MACHINE_EXTRA_RRECOMMENDS += "kernel-modules"
```

## meta-ngt/conf/machine/atlas.conf
```bitbake
#@TYPE: Machine
#@NAME: cyclone5
#@DESCRIPTION: Machine configuration for the Cyclone V SoC" 

require conf/machine/include/socfpga.inc

PREFERRED_PROVIDER_virtual/kernel ?= "linux-yocto-hbk"

KERNEL_DEVICETREE = "marvell/armada-3720-espressobin.dtb"

IMAGE_BOOT_FILES_append = " Image-armada-3720-espressobin.dtb;fdt.dtb"

KERNEL_IMAGETYPE = "Image"

PREFERRED_PROVIDER_virtual/bootloader ?= "u-boot-marvell"
PREFERRED_PROVIDER_u-boot ?= "u-boot-marvell"

UBOOT_MACHINE = "mvebu_espressobin-88f3720_defconfig"
UBOOT_DEVICE_TREE = "armada-3720-espressobin"
ARM_TRUSTED_FIRMWARE_PLATFORM = "a3700"

MACHINE_EXTRA_RRECOMMENDS += "kernel-modules"
```

## meta-ngt/conf/machine/factory.conf
```bitbake
#@TYPE: Machine
#@NAME: HBK NGT Board
#@SOC: SocFPGA
#@DESCRIPTION: Machine configuration for NGT

### from openembedded-core/meta/conf/machine/include
require conf/machine/include/tune-cortexa9.inc

KERNEL_PROVIDER ?= "linux-ngt"
PREFERRED_PROVIDER_virtual/kernel ?= "${KERNEL_PROVIDER}"

PREFERRED_PROVIDER_virtual/bootloader ?= "barebox"

RDEPENDS_barebox_factory += "barebox-preloader"

#IMAGE_FSTYPES =

# MACHINE_EXTRA_RRECOMMENDS += "kernel-modules"
```

## meta-ngt/conf/machine/ngt-board.conf
```bitbake
#@TYPE: Machine
#@NAME: HBK NGT Board
#@SOC: SocFPGA
#@DESCRIPTION: Machine configuration for NGT

### from openembedded-core/meta/conf/machine/include
require conf/machine/include/tune-cortexa9.inc

KERNEL_PROVIDER ?= "linux-ngt"
PREFERRED_PROVIDER_virtual/kernel ?= "${KERNEL_PROVIDER}"

PREFERRED_PROVIDER_virtual/bootloader ?= "barebox"

BAREBOX_BOOTLOADER_IMAGE_ngt-board = "images/barebox-ngtboard.img"
BAREBOX_PRELOADER_IMAGE_ngt-board  = "images/preloader_ngtboard.img"

#RDEPENDS_barebox-preloader_ngt-board = "barebox"
RDEPENDS_barebox_ngt-board += "barebox-preloader"


#IMAGE_FSTYPES =


MACHINE_EXTRA_RRECOMMENDS += "kernel-modules"
```
